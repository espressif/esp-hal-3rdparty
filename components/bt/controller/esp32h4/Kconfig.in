## components/bt/controller/esp32h4/Kconfig.in
```kconfig
choice
    prompt "Bluetooth controller mode (BR/EDR/BLE/DUALMODE)"
    help
        Specify the bluetooth controller mode (BR/EDR, BLE or dual mode).

    config BTDM_CTRL_MODE_BLE_ONLY
        bool "BLE Only"
        depends on SOC_BLE_SUPPORTED

    config BTDM_CTRL_MODE_BR_EDR_ONLY
        bool "BR/EDR Only"
        depends on SOC_BT_CLASSIC_SUPPORTED

    config BTDM_CTRL_MODE_BTDM
        bool "Bluetooth Dual Mode"
        depends on SOC_BLE_SUPPORTED && SOC_BT_CLASSIC_SUPPORTED
endchoice

choice BT_CTRL_PINNED_TO_CORE_CHOICE
    prompt "The cpu core which bluetooth controller run"
    depends on !FREERTOS_UNICORE
    help
        Specify the cpu core to run bluetooth controller.
        Can not specify no-affinity.

    config BT_CTRL_PINNED_TO_CORE_CHOICE_0
        bool "Core 0 (PRO CPU)"
    config BT_CTRL_PINNED_TO_CORE_CHOICE_1
        bool "Core 1 (APP CPU)"
        depends on !FREERTOS_UNICORE
endchoice

config BT_CTRL_PINNED_TO_CORE
    int
    default 0 if BT_CTRL_PINNED_TO_CORE_CHOICE_0
    default 1 if BT_CTRL_PINNED_TO_CORE_CHOICE_1
    default 0

config BT_CTRL_TASK_STACK_SIZE
    int "Controller task stack size"
    default 5120 if BLE_MESH
    default 4096
    help
        This configures stack size of NimBLE controller task

config BT_CTRL_SLEEP_ENABLE
    bool "Enable Bluetooth Controller sleep"
    default n
    help
        Enable Bluetooth Controller sleep

menu "Bluetooth controller HCI"
    config BT_CTRL_HCI_CMD_NUM
        int "HCI CMD buffer number"
        range 1 255
        default 5

    choice BT_CTRL_HCI_INTERFACE
        prompt "HCI mode"
        default BT_CTRL_HCI_INTERFACE_USE_RAM

        config BT_CTRL_HCI_INTERFACE_USE_RAM
            bool "VHCI"
            help
                Use RAM as HCI interface
        config BT_CTRL_HCI_INTERFACE_USE_UART
            bool "UART(H4)"
            help
                Use UART as HCI interface
    endchoice

    choice BT_CTRL_UART_HCI_MODE_CHOICE
        prompt "UART HCI mode"
        depends on BT_CTRL_HCI_INTERFACE_USE_UART
        default BT_CTRL_UART_HCI_NO_DMA_MODE
        help
            Specify UART HCI mode: DMA or No DMA

        config BT_CTRL_UART_HCI_DMA_MODE
            bool "UHCI(UART with DMA)(EXPERIMENTAL)"
            help
                UART HCI Mode with DMA functionality.

        config BT_CTRL_UART_HCI_NO_DMA_MODE
            bool "UART(NO DMA)"
            help
                UART HCI Mode without DMA functionality.
    endchoice

    config BT_CTRL_HCI_UART_PORT
        int "HCI UART port"
        depends on BT_CTRL_HCI_INTERFACE_USE_UART
        default 1
        help
            Set the port number of HCI UART

    config BT_CTRL_HCI_UART_FLOWCTRL
        bool "HCI uart Hardware Flow ctrl"
        depends on BT_CTRL_HCI_INTERFACE_USE_UART
        default n

    config BT_CTRL_HCI_UART_TX_PIN
        int "HCI uart Tx gpio"
        depends on BT_CTRL_HCI_INTERFACE_USE_UART
        default 19

    config BT_CTRL_HCI_UART_RX_PIN
        int "HCI uart Rx gpio"
        depends on BT_CTRL_HCI_INTERFACE_USE_UART
        default 10

    config BT_CTRL_HCI_UART_RTS_PIN
        int "HCI uart RTS gpio"
        depends on BT_CTRL_HCI_UART_FLOWCTRL
        default 4

    config BT_CTRL_HCI_UART_CTS_PIN
        int "HCI uart CTS gpio"
        depends on BT_CTRL_HCI_UART_FLOWCTRL
        default 5

    config BT_CTRL_HCI_UART_BAUD
        int "HCI uart baudrate"
        depends on BT_CTRL_HCI_INTERFACE_USE_UART
        default 921600
        help
            HCI uart baud rate 115200 ~ 1000000

    choice BT_CTRL_HCI_UART_PARITY
        prompt "select uart parity"
        depends on BT_CTRL_HCI_INTERFACE_USE_UART
        default BT_CTRL_HCI_UART_UART_PARITY_DISABLE

        config BT_CTRL_HCI_UART_UART_PARITY_DISABLE
            bool "PARITY_DISABLE"
            help
                UART_PARITY_DISABLE
        config BT_CTRL_HCI_UART_UART_PARITY_EVEN
            bool "PARITY_EVEN"
            help
                UART_PARITY_EVEN
        config BT_CTRL_HCI_UART_UART_PARITY_ODD
            bool "PARITY_ODD"
            help
                UART_PARITY_ODD
    endchoice

    config BT_CTRL_HCI_UART_RX_BUFFER_SIZE
        int "The size of rx ring buffer memory"
        depends on BT_CTRL_UART_HCI_NO_DMA_MODE
        default 512
        help
            The size of rx ring buffer memory

    config BT_CTRL_HCI_UART_TX_BUFFER_SIZE
        int "The size of tx ring buffer memory"
        depends on BT_CTRL_UART_HCI_NO_DMA_MODE
        default 256
        help
            The size of tx ring buffer memory

    config BT_CTRL_HCI_TRANS_TASK_STACK_SIZE
        int "HCI transport task stack size"
        depends on !BT_CTRL_HCI_INTERFACE_USE_RAM
        default 1024
        help
            This configures stack size of hci transport task

    config BT_CTRL_HCI_TRANS_RX_MEM_NUM
        int "The amount of rx memory received at the same time"
        depends on BT_CTRL_UART_HCI_DMA_MODE
        default 3
        help
            The amount of rx memory received at the same time

    config BT_CTRL_HCI_LLDESCS_POOL_NUM
        int "The amount of lldecs memory for driver dma mode"
        depends on BT_CTRL_UART_HCI_DMA_MODE
        default 20
        help
            The amount of lldecs memory for driver dma mode
endmenu

menu "BLE Controller Settings"
    depends on BTDM_CTRL_MODE_BLE_ONLY || BTDM_CTRL_MODE_BTDM
    source "$IDF_PATH/components/bt/controller/$IDF_TARGET/Kconfig.ble.in"
endmenu

config BT_DUAL_MODE_ARCH
    bool
    default y
```
